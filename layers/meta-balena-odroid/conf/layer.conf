## layers/meta-balena-odroid/conf/layer.conf
```bitbake
BBPATH .= ":${LAYERDIR}"

BBFILES += "${LAYERDIR}/recipes-*/*/*.bb \
            ${LAYERDIR}/recipes-*/*/*.bbappend"

BBFILE_COLLECTIONS += "balena-odroid"
BBFILE_PATTERN_balena-odroid := "^${LAYERDIR}/"
BBFILE_PRIORITY_balena-odroid = "1337"

LAYERSERIES_COMPAT_balena-odroid = "warrior"
```

## layers/meta-resin-odroid/conf/layer.conf
```bitbake
BBPATH .= ":${LAYERDIR}"

BBFILES += "${LAYERDIR}/recipes-*/*/*.bb \
            ${LAYERDIR}/recipes-*/*/*.bbappend"

BBFILE_COLLECTIONS += "resin-odroid"
BBFILE_PATTERN_resin-odroid := "^${LAYERDIR}/"
BBFILE_PRIORITY_resin-odroid = "1337"

LAYERSERIES_COMPAT_resin-odroid = "sumo"

PREFERRED_VERSION_u-boot = "2017.09"
```
